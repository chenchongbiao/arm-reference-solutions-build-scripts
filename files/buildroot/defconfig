## files/buildroot/defconfig
```kconfig
BR2_aarch64=y
BR2_CCACHE=y
BR2_TOOLCHAIN_EXTERNAL=y
BR2_TOOLCHAIN_EXTERNAL_CUSTOM=y
BR2_TOOLCHAIN_EXTERNAL_PATH="${AARCH64_LINUX}/.."
BR2_TOOLCHAIN_EXTERNAL_CUSTOM_PREFIX="$(ARCH)-none-linux-gnu"
BR2_TOOLCHAIN_EXTERNAL_GCC_11=y
BR2_TOOLCHAIN_EXTERNAL_HEADERS_4_20=y
BR2_TOOLCHAIN_EXTERNAL_CUSTOM_GLIBC=y
BR2_TOOLCHAIN_EXTERNAL_CXX=y
# BR2_TOOLCHAIN_EXTERNAL_INET_RPC is not set
BR2_ROOTFS_OVERLAY="board/arm/total-compute/rootfs-overlay"
BR2_ROOTFS_POST_BUILD_SCRIPT="${PWD}/../../build-scripts/files/buildroot/post-build.sh"
BR2_TARGET_ROOTFS_CPIO=y
BR2_TARGET_ROOTFS_CPIO_GZIP=y
BR2_TARGET_ROOTFS_CPIO_UIMAGE=y
BR2_PACKAGE_UTIL_LINUX=y
BR2_PACKAGE_UTIL_LINUX_BINARIES=y
BR2_PACKAGE_UTIL_LINUX_SCHEDUTILS=y
BR2_PACKAGE_OPENSSH=y
BR2_PACKAGE_HAVEGED=y
# BR2_TARGET_ROOTFS_TAR is not set
BR2_PACKAGE_BUSYBOX_CONFIG_FRAGMENT_FILES="${PWD}/../../build-scripts/files/buildroot/busybox_netcat.cfg"
```

## files/buildroot/external_packages/package/vector_workload/Config.in
```kconfig
config BR2_PACKAGE_VECTOR_WORKLOAD
	bool "vector_workload"
	help
	  vector_workload is a small c application, that runs vector instructions
	  in a continuous while loop.
```
